/ {
	model = "PJRC TEENSY 4.0 board";
	compatible = "nxp,mimxrt1062";

	aliases {
		csled = &board_led22;
	};

	leds {
		compatible = "gpio-leds";
		board_led22: led-2 {
			gpios = <&gpio2 3 GPIO_ACTIVE_HIGH>;
			label = "Rohit LED Pin 13";
		};
	};
};